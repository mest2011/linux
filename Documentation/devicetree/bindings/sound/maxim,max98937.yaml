## Documentation/devicetree/bindings/sound/maxim,max98937.yaml
```yaml
# SPDX-License-Identifier: (GPL-2.0-only OR BSD-2-Clause)
%YAML 1.2
---
$id: http://devicetree.org/schemas/sound/maxim,max98937.yaml#
$schema: http://devicetree.org/meta-schemas/core.yaml#

title: Maxim Integrated MAX98937 speaker amplifier

maintainers:
  - Miguel Sobral Teixeira <mest2011mest@gmail.com>

description:
  The MAX98937 is a boosted class-D speaker amplifier with an I2S input,
  controlled over I2C. Its register map differs from the MAX98927.

allOf:
  - $ref: dai-common.yaml#

properties:
  compatible:
    const: maxim,max98937

  reg:
    maxItems: 1

  '#sound-dai-cells':
    const: 0

  reset-gpios:
    maxItems: 1

  vdd-supply:
    description: 1.8 V digital supply

required:
  - compatible
  - reg
  - '#sound-dai-cells'

unevaluatedProperties: false

examples:
  - |
    #include <dt-bindings/gpio/gpio.h>

    i2c {
        #address-cells = <1>;
        #size-cells = <0>;

        audio-codec@3a {
            compatible = "maxim,max98937";
            reg = <0x3a>;
            #sound-dai-cells = <0>;
            reset-gpios = <&tlmm 77 GPIO_ACTIVE_LOW>;
            vdd-supply = <&vreg_l6b_1p8>;
        };
    };
```
